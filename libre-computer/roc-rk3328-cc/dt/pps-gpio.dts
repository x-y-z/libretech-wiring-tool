/dts-v1/;
/plugin/;

#include <dt-bindings/gpio/gpio.h>
#include <dt-bindings/pinctrl/rockchip.h>

/ {
	compatible = "rockchip,rk3328";

	fragment@0 {
		target-path = "/";
		__overlay__ {
			pps {
				gpios = <&gpio1 28 GPIO_ACTIVE_HIGH>;
				compatible = "pps-gpio";
				status = "okay";
			};
		};
	};
};
